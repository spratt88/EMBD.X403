
/* ULP variable definitions for the linker.
 * This file is generated automatically by esp32ulp_mapgen.py utility.
 */
PROVIDE ( ulp_acce = 0x50000acc );
PROVIDE ( ulp_accex_threshold = 0x50000abe );
PROVIDE ( ulp___clzsi2 = 0x50000424 );
PROVIDE ( ulp___clz_tab = 0x5000099c );
PROVIDE ( ulp___divsf3 = 0x50000032 );
PROVIDE ( ulp___eqsf2 = 0x50000278 );
PROVIDE ( ulp___floatsisf = 0x50000366 );
PROVIDE ( ulp___gesf2 = 0x500002d2 );
PROVIDE ( ulp___gtsf2 = 0x500002d2 );
PROVIDE ( ulp_gyro = 0x50000ac0 );
PROVIDE ( ulp_gyrox_threshold = 0x50000abc );
PROVIDE ( ulp_irq_vector = 0x50000010 );
PROVIDE ( ulp_main = 0x5000060e );
PROVIDE ( ulp_mpu_config = 0x5000045e );
PROVIDE ( ulp_mpu_get_acce = 0x5000049a );
PROVIDE ( ulp_mpu_get_gyro = 0x50000554 );
PROVIDE ( ulp___nesf2 = 0x50000278 );
PROVIDE ( ulp_reset_vector = 0x50000000 );
PROVIDE ( ulp_SENS = 0x5000c800 );
PROVIDE ( ulp___stack_top = 0x50001000 );
PROVIDE ( ulp_ulp_riscv_halt = 0x5000093a );
PROVIDE ( ulp_ulp_riscv_i2c_master_read_from_device = 0x500006d4 );
PROVIDE ( ulp_ulp_riscv_i2c_master_set_slave_addr = 0x5000069a );
PROVIDE ( ulp_ulp_riscv_i2c_master_set_slave_reg_addr = 0x500006b4 );
PROVIDE ( ulp_ulp_riscv_i2c_master_write_to_device = 0x50000814 );
PROVIDE ( ulp_ulp_riscv_rescue_from_monitor = 0x5000091a );
PROVIDE ( ulp_ulp_riscv_wakeup_main_processor = 0x5000092e );
